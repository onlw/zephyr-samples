## CMakeLists.txt
```
# SPDX-License-Identifier: Apache-2.0

cmake_minimum_required(VERSION 3.20.0)

find_package(Zephyr REQUIRED HINTS $ENV{ZEPHYR_BASE})
project(wifi_auto_reconnect)

target_sources(app PRIVATE src/main.c)
```

## Kconfig
```
# Copyright 2025 NXP
# SPDX-License-Identifier: Apache-2.0

mainmenu "Network Wi-Fi apsta_mode application"

config WIFI_SAMPLE_AP_SSID
	string "SSID of soft AP"
	default "NOT_USED"
	help
	  SSID of the soft AP created by the sample.
	  Fox example: "SOFT-AP"

config WIFI_SAMPLE_AP_PSK
	string "Pre-shared key for soft AP"
	default "NOT_USED"
	help
	  WPA2 password used by the soft AP for client authentication.
	  For example: "PSK"

config WIFI_SAMPLE_SSID
	string "ZeahoGuestWIFI"
	help
	  SSID of the access point to connect to in station mode.
	  For example: "TARGET-AP"

config WIFI_SAMPLE_PSK
	string "zeaho2021"
	help
	  WPA2 password used to connect to the target AP.
	  For example: "PSK"

config WIFI_SAMPLE_DHCPV4_START
	bool "Start DHCPv4 server in application layer."
	default y
	help
	  Enable this option to start the DHCPv4 server from the application layer,
	  typically before the Soft AP is initialized.

	  When disabled, the DHCPv4 server startup timing is determined by the vendor's
	  implementation. In some cases, the server may be started after the AP is up,
	  using the vendor's default IP address, gateway, subnet mask.


if WIFI_SAMPLE_DHCPV4_START

# Some vendors start the DHCPv4 server after Soft AP initialization,
# using default IP address and subnet mask. In such cases, manual
# configuration of gateway and netmask may not be necessary.
# The following options are used only if the DHCPv4 server is started
# by the application.

config WIFI_SAMPLE_AP_IP_ADDRESS
	string "IP address of soft AP"
	help
	  IP address assigned to the soft AP interface.
	  For example: "192.168.4.1"

config WIFI_SAMPLE_AP_NETMASK
	string "Netmask of soft AP"
	help
	  Subnet mask for the soft AP interface.
	  For example: "255.255.255.0"
endif # WIFI_SAMPLE_DHCPV4_START

source "Kconfig.zephyr"
```

## prj.conf
```kconfig
# 基础 Wi-Fi 配置
CONFIG_WIFI=y



# ESP32 自动重连配置
CONFIG_NETWORKING=y
CONFIG_NET_L2_WIFI_MGMT=y
CONFIG_NET_L2_ETHERNET=y
CONFIG_NET_IPV4=y
CONFIG_ESP32_WIFI_STA_RECONNECT=y

# 日志系统
CONFIG_LOG=y
CONFIG_LOG_DEFAULT_LEVEL=3

# UART 控制台 / Shell
CONFIG_UART_CONSOLE=y
CONFIG_SHELL=y
CONFIG_SHELL_BACKEND_SERIAL=y
```

## src/main.c
```c
#include <zephyr/kernel.h>
#include <zephyr/net/wifi_mgmt.h>
#include <zephyr/net/net_if.h>
#include <zephyr/net/net_mgmt.h>
#include <zephyr/logging/log.h>

LOG_MODULE_REGISTER(wifi_auto, LOG_LEVEL_INF);

// #define WIFI_SSID "ZeahoGuestWIFI"       // 修改为你的 Wi-Fi 名称
// #define WIFI_PASS "zeaho2021"   // 修改为你的 Wi-Fi 密码
#define WIFI_SSID "tmkwifi"       // 修改为你的 Wi-Fi 名称
#define WIFI_PASS "12345678"   // 修改为你的 Wi-Fi 密码

int main(void)
{
    struct net_if *iface = net_if_get_default();
    struct wifi_connect_req_params wifi_params = {
        .ssid = WIFI_SSID,
        .ssid_length = sizeof(WIFI_SSID) - 1,
        .psk = WIFI_PASS,
        .psk_length = sizeof(WIFI_PASS) - 1,
        .security = WIFI_SECURITY_TYPE_PSK,
        .channel = WIFI_CHANNEL_ANY,
    };

    LOG_INF("Starting Wi-Fi auto reconnect demo");

    int ret = net_mgmt(NET_REQUEST_WIFI_CONNECT, iface,
                       &wifi_params, sizeof(wifi_params));
    if (ret) {
        LOG_ERR("Failed to initiate Wi-Fi connection: %d", ret);
    }

    while (1) {
        struct wifi_iface_status status = { 0 };
        int ret;

        // 获取 WiFi 接口状态
        ret = net_mgmt(NET_REQUEST_WIFI_IFACE_STATUS, iface,
                      &status, sizeof(struct wifi_iface_status));

        if (ret == 0) {
            LOG_INF("WiFi Status - State: %d, SSID: %s, RSSI: %d dBm, Channel: %d",
                   status.state, status.ssid, status.rssi, status.channel);

            // 打印连接状态的文字描述
            if (status.state == WIFI_STATE_COMPLETED) {
                printk("WiFi: CONNECTED to %s (RSSI: %d dBm)\n",
                      status.ssid, status.rssi);
            } else if (status.state == WIFI_STATE_DISCONNECTED) {
                printk("WiFi: DISCONNECTED\n");
            } else if (status.state == WIFI_STATE_SCANNING) {
                printk("WiFi: SCANNING\n");
            } else if (status.state == WIFI_STATE_ASSOCIATING) {
                printk("WiFi: ASSOCIATING\n");
            } else if (status.state == WIFI_STATE_ASSOCIATED) {
                printk("WiFi: ASSOCIATED\n");
            } else if (status.state == WIFI_STATE_4WAY_HANDSHAKE) {
                printk("WiFi: 4-WAY HANDSHAKE\n");
            } else {
                printk("WiFi: UNKNOWN STATE (%d)\n", status.state);
            }
        } else {
            LOG_ERR("Failed to get WiFi status: %d", ret);
            printk("WiFi: Status unavailable\n");
        }

        printk("Uptime: %d ms\n", k_uptime_get_32());

        k_sleep(K_SECONDS(5));
    }
}
```
