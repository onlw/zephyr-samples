## CMakeLists.txt
```
# SPDX-License-Identifier: Apache-2.0

cmake_minimum_required(VERSION 3.20.0)

find_package(Zephyr REQUIRED HINTS $ENV{ZEPHYR_BASE})
project(serial)

target_sources(app PRIVATE src/main.c)
```

## prj.conf
```kconfig
# nothing here
# CONFIG_SERIAL=y
```

## src/main.c
```c
/*
 * Copyright (c) 2012-2014 Wind River Systems, Inc.
 *
 * SPDX-License-Identifier: Apache-2.0
 */

#include <stdio.h>
#include <zephyr/kernel.h>

int main(void)
{
	int i = 0;
    while(1) {
        k_sleep(K_MSEC(2000));
        printk("Hello World! %s %d\n", CONFIG_BOARD, i++);
    }
}
```
